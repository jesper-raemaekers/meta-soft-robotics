## conf/distro/softrobotics.conf
```bitbake
require conf/distro/poky.conf

DISTRO_NAME = "Soft Robotics Toolkit"
DISTRO_VERSION = "2023.11"


DISTRO_FEATURES:append = " systemd"

VIRTUAL-RUNTIME_init_manager = "systemd"
VIRTUAL-RUNTIME_initscript = "systemd-compat-units"

IMAGE_INSTALL:append = " veab-tools"

IMAGE_FSTYPES:append=" rpi-sdimg"

CORE_IMAGE_EXTRA_INSTALL:append = " nano htop"

EXTRA_IMAGEDEPENDS += "rpi-bootfiles"
EXTRA_IMAGE_FEATURES:append = " ssh-server-dropbear"
```

## conf/layer.conf
```bitbake
# We have a conf and classes directory, add to BBPATH
BBPATH .= ":${LAYERDIR}"

# We have recipes-* directories, add to BBFILES
BBFILES += "${LAYERDIR}/recipes-*/*/*.bb \
            ${LAYERDIR}/recipes-*/*/*.bbappend"

BBFILE_COLLECTIONS += "meta-soft-robot-control"
BBFILE_PATTERN_meta-soft-robot-control = "^${LAYERDIR}/"
BBFILE_PRIORITY_meta-soft-robot-control = "6"

LAYERDEPENDS_meta-soft-robot-control = "core"
LAYERSERIES_COMPAT_meta-soft-robot-control = "mickledore"


MACHINE = "raspberrypi4-64"
DISTRO = "softrobotics"
```
